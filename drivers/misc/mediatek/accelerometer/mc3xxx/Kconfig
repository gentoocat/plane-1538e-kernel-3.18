## drivers/misc/mediatek/accelerometer/mc3xxx/Kconfig
```kconfig
config MTK_MC3XXX
        bool "MTK_MC3XXX for MediaTek package"
        default n
```

## drivers/misc/mediatek/alsps/epl89xx-new/Kconfig
```kconfig
config MTK_EPL89XX_NEW
	bool "MTK_EPL89XX_NEW for MediaTek package"
	default n
	help
	It support different type sensor
	in this platform. If this option
	is set, it will support ambient
	and light sensor MTK_EPL89XX_NEW.
```

## drivers/misc/mediatek/alsps/ltr5xx/Kconfig
```kconfig
config MTK_LTR5XX
	bool "ltr5xx for MediaTek package"
	default n
	help
	It support different type sensor
	in this platform. If this option
	is set, it will support ambient
	and light sensor ltr5xx.
```
