/*************************
 * Customized Battery Setting dtsi file
*************************/
&bat_comm {
	/* cust_charging.h */

	/* Charging Current Setting */
	usb_charger_current = <50000 >;	/* Unit: 0.01 mA */
	ac_charger_input_current = <200000 >; /* Unit: 0.01 mA */
	ac_charger_current = <200000 >;	/* Unit: 0.01 mA */
	non_std_ac_charger_current = <50000 >;	/* Unit: 0.01 mA */
	charging_host_charger_current = <50000 >;	/* Unit: 0.01 mA */

	/* charger error check */
	bat_low_temp_protect_enable = <0 >;
	v_charger_enable = <0 >;	/* 1:on , 0:off */
	v_charger_max = <6500 >;	/* unit: mV */
	v_charger_min = <4400 >;

	/*  Tracking TIME */
	onehundred_percent_tracking_time = <10 >;	/* Unit: second */
	npercent_tracking_time = <20 >;	/* Unit: second */
	sync_to_real_tracking_time = <60 >;	/* Unit: second */
	v_0percent_tracking = <3450 >;	/* Unit: mV */

	/* High battery support */
	high_battery_voltage_support = <1 >;
};

&bat_meter {
	/* cust_battery_meter.h */
	/* ADC resistor  */
	r_bat_sense = <4 >;
	r_i_sense = <4 >;
	r_charger_1 = <330 >;
	r_charger_2 = <39 >;
	temperature_t0 = <110 >;
	temperature_t1 = <0 >;
	temperature_t2 = <25 >;
	temperature_t3 = <50 >;
	temperature_t = <255 >;	/* this should be fixed, never change the value */
	fg_meter_resistance = <0 >;

	/* Qmax for 0mA */
	q_max_pos_50 = <2469>;
	q_max_pos_25 = <2469>;
	q_max_pos_0 = <2469>;
	q_max_neg_10 = <2469>;
	/* Qmax for 400mA, said high current */
	q_max_pos_50_h_current = <2409>;
	q_max_pos_25_h_current = <2409>;
	q_max_pos_0_h_current = <2409>;
	q_max_neg_10_h_current = <2409>;
	/* Discharge percentage, 1: D5, 0: D2 */
	oam_d5 = <1 >;

	change_tracking_point = <1 >;
	/* SW OCV tracking setting */
	cust_tracking_point = <1 >;
	cust_r_sense = <68 >;
	cust_hw_cc = <0 >;
	aging_tuning_value = <103 >;
	cust_r_fg_offset = <0 >;
	ocv_board_compesate = <0 >;
	r_fg_board_base = <1000 >;
	r_fg_board_slope = <1000 >;
	car_tune_value = <84 >;

	/* HW Fuel gague  */
	current_detect_r_fg = <10 >;	/* Unit: mA */
	minerroroffset = <1000 >;
	fg_vbat_average_size = <18 >;
	r_fg_value = <10 >;	/* Unit: mOhm */

	cust_poweron_delta_capacity_tolrance = <30 >;
	cust_poweron_low_capacity_tolrance = <5 >;
	cust_poweron_max_vbat_tolrance = <90 >;
	cust_poweron_delta_vbat_tolrance = <30 >;
	cust_poweron_delta_hw_sw_ocv_capacity_tolrance = <10 >;

	/* Fixed battery temperature */
	fixed_tbat_25 = <0 >;

	/* Battery remove detecton */
	vbat_remove_detection = <0>;

	/* Dynamic change wake up period of battery thread when suspend */
	vbat_normal_wakeup = <3600 >;	/* Unit: mV */
	vbat_low_power_wakeup = <3500 >;	/* Unit: mV */
	normal_wakeup_period = <5400 >;	/* Unit: second */
	low_power_wakeup_period = <300 >;	/* Unit: second */
	close_poweroff_wakeup_period = <30 >;	/* Unit: second */

	rbat_pull_up_r = <16900 >;
	rbat_pull_up_volt = <1800 >;

	batt_temperature_table_num = <17 >;
	batt_temperature_table = <
	    (-20) 69989
	    (-15) 54856
	    (-10) 43322
	    (-5) 34461
	    0 27604
	    5 22263
	    10 18063
	    15 14746
	    20 12109
	    25 10000
	    30 8303
	    35 6930
	    40 5813
	    45 4899
	    50 4155
	    55 3538
	    60 3023
	>;

	battery_profile_t0_num = <100 >;
	battery_profile_t0 = <
	    0  4308
	    1  4281
	    2  4264
	    3  4249
	    4  4236
	    5  4223
	    6  4210
	    7  4198
	    9  4187
	    10 4175
	    11 4163
	    12 4153
	    13 4141
	    14 4130
	    15 4118
	    16 4107
	    17 4097
	    18 4087
	    19 4080
	    20 4076
	    21 4066
	    22 4050
	    24 4031
	    25 4014
	    26 4000
	    27 3991
	    28 3983
	    29 3978
	    30 3973
	    31 3968
	    32 3961
	    33 3953
	    34 3945
	    35 3937
	    36 3930
	    37 3921
	    38 3912
	    40 3901
	    41 3891
	    42 3881
	    43 3871
	    44 3862
	    45 3855
	    46 3849
	    47 3843
	    48 3838
	    49 3833
	    50 3828
	    51 3824
	    52 3819
	    53 3815
	    54 3811
	    55 3808
	    57 3805
	    58 3802
	    59 3799
	    60 3796
	    61 3793
	    62 3790
	    63 3788
	    64 3786
	    65 3784
	    66 3781
	    67 3779
	    68 3777
	    69 3775
	    70 3773
	    72 3770
	    73 3767
	    74 3763
	    75 3760
	    76 3756
	    77 3752
	    78 3748
	    79 3745
	    80 3742
	    81 3740
	    82 3735
	    83 3730
	    84 3725
	    85 3720
	    86 3717
	    88 3711
	    89 3703
	    90 3697
	    91 3695
	    92 3693
	    93 3691
	    94 3689
	    95 3681
	    96 3655
	    97 3608
	    98 3548
	    99 3466
	    100 3425
	    100 3401
	    100 3387
	    100 3377
	    100 3369
	>;

	battery_profile_t1_num = <100 >;
	battery_profile_t1 = <
	    0  4308
	    1  4281
	    2  4264
	    3  4249
	    4  4236
	    5  4223
	    6  4210
	    7  4198
	    9  4187
	    10 4175
	    11 4163
	    12 4153
	    13 4141
	    14 4130
	    15 4118
	    16 4107
	    17 4097
	    18 4087
	    19 4080
	    20 4076
	    21 4066
	    22 4050
	    24 4031
	    25 4014
	    26 4000
	    27 3991
	    28 3983
	    29 3978
	    30 3973
	    31 3968
	    32 3961
	    33 3953
	    34 3945
	    35 3937
	    36 3930
	    37 3921
	    38 3912
	    40 3901
	    41 3891
	    42 3881
	    43 3871
	    44 3862
	    45 3855
	    46 3849
	    47 3843
	    48 3838
	    49 3833
	    50 3828
	    51 3824
	    52 3819
	    53 3815
	    54 3811
	    55 3808
	    57 3805
	    58 3802
	    59 3799
	    60 3796
	    61 3793
	    62 3790
	    63 3788
	    64 3786
	    65 3784
	    66 3781
	    67 3779
	    68 3777
	    69 3775
	    70 3773
	    72 3770
	    73 3767
	    74 3763
	    75 3760
	    76 3756
	    77 3752
	    78 3748
	    79 3745
	    80 3742
	    81 3740
	    82 3735
	    83 3730
	    84 3725
	    85 3720
	    86 3717
	    88 3711
	    89 3703
	    90 3697
	    91 3695
	    92 3693
	    93 3691
	    94 3689
	    95 3681
	    96 3655
	    97 3608
	    98 3548
	    99 3466
	    100 3425
	    100 3401
	    100 3387
	    100 3377
	    100 3369
	>;

	battery_profile_t2_num = <100 >;
	battery_profile_t2 = <
	    0  4308
	    1  4281
	    2  4264
	    3  4249
	    4  4236
	    5  4223
	    6  4210
	    7  4198
	    9  4187
	    10 4175
	    11 4163
	    12 4153
	    13 4141
	    14 4130
	    15 4118
	    16 4107
	    17 4097
	    18 4087
	    19 4080
	    20 4076
	    21 4066
	    22 4050
	    24 4031
	    25 4014
	    26 4000
	    27 3991
	    28 3983
	    29 3978
	    30 3973
	    31 3968
	    32 3961
	    33 3953
	    34 3945
	    35 3937
	    36 3930
	    37 3921
	    38 3912
	    40 3901
	    41 3891
	    42 3881
	    43 3871
	    44 3862
	    45 3855
	    46 3849
	    47 3843
	    48 3838
	    49 3833
	    50 3828
	    51 3824
	    52 3819
	    53 3815
	    54 3811
	    55 3808
	    57 3805
	    58 3802
	    59 3799
	    60 3796
	    61 3793
	    62 3790
	    63 3788
	    64 3786
	    65 3784
	    66 3781
	    67 3779
	    68 3777
	    69 3775
	    70 3773
	    72 3770
	    73 3767
	    74 3763
	    75 3760
	    76 3756
	    77 3752
	    78 3748
	    79 3745
	    80 3742
	    81 3740
	    82 3735
	    83 3730
	    84 3725
	    85 3720
	    86 3717
	    88 3711
	    89 3703
	    90 3697
	    91 3695
	    92 3693
	    93 3691
	    94 3689
	    95 3681
	    96 3655
	    97 3608
	    98 3548
	    99 3466
	    100 3425
	    100 3401
	    100 3387
	    100 3377
	    100 3369
	>;

	battery_profile_t3_num = <100 >;
	battery_profile_t3 = <
	    0  4308
	    1  4281
	    2  4264
	    3  4249
	    4  4236
	    5  4223
	    6  4210
	    7  4198
	    9  4187
	    10 4175
	    11 4163
	    12 4153
	    13 4141
	    14 4130
	    15 4118
	    16 4107
	    17 4097
	    18 4087
	    19 4080
	    20 4076
	    21 4066
	    22 4050
	    24 4031
	    25 4014
	    26 4000
	    27 3991
	    28 3983
	    29 3978
	    30 3973
	    31 3968
	    32 3961
	    33 3953
	    34 3945
	    35 3937
	    36 3930
	    37 3921
	    38 3912
	    40 3901
	    41 3891
	    42 3881
	    43 3871
	    44 3862
	    45 3855
	    46 3849
	    47 3843
	    48 3838
	    49 3833
	    50 3828
	    51 3824
	    52 3819
	    53 3815
	    54 3811
	    55 3808
	    57 3805
	    58 3802
	    59 3799
	    60 3796
	    61 3793
	    62 3790
	    63 3788
	    64 3786
	    65 3784
	    66 3781
	    67 3779
	    68 3777
	    69 3775
	    70 3773
	    72 3770
	    73 3767
	    74 3763
	    75 3760
	    76 3756
	    77 3752
	    78 3748
	    79 3745
	    80 3742
	    81 3740
	    82 3735
	    83 3730
	    84 3725
	    85 3720
	    86 3717
	    88 3711
	    89 3703
	    90 3697
	    91 3695
	    92 3693
	    93 3691
	    94 3689
	    95 3681
	    96 3655
	    97 3608
	    98 3548
	    99 3466
	    100 3425
	    100 3401
	    100 3387
	    100 3377
	    100 3369
	>;

	r_profile_t0_num = <100 >;
	r_profile_t0 = <
	    155 4308
	    155 4281
	    159 4264
	    160 4249
	    163 4236
	    165 4223
	    166 4210
	    169 4198
	    171 4187
	    171 4175
	    171 4163
	    175 4153
	    175 4141
	    178 4130
	    178 4118
	    180 4107
	    183 4097
	    184 4087
	    185 4080
	    191 4076
	    193 4066
	    191 4050
	    191 4031
	    193 4014
	    193 4000
	    196 3991
	    184 3983
	    200 3978
	    205 3973
	    206 3968
	    204 3961
	    203 3953
	    199 3945
	    198 3937
	    195 3930
	    190 3921
	    190 3912
	    189 3901
	    178 3891
	    171 3881
	    168 3871
	    166 3862
	    159 3855
	    156 3849
	    155 3843
	    155 3838
	    156 3833
	    158 3828
	    158 3824
	    156 3819
	    158 3815
	    158 3811
	    159 3808
	    160 3805
	    161 3802
	    163 3799
	    163 3796
	    164 3793
	    164 3790
	    165 3788
	    166 3786
	    168 3784
	    166 3781
	    166 3779
	    166 3777
	    165 3775
	    164 3773
	    161 3770
	    160 3767
	    156 3763
	    155 3760
	    153 3756
	    151 3752
	    149 3748
	    150 3745
	    150 3742
	    154 3740
	    154 3735
	    154 3730
	    156 3725
	    158 3720
	    160 3717
	    169 3711
	    170 3703
	    173 3697
	    178 3695
	    184 3693
	    191 3691
	    201 3689
	    211 3681
	    211 3655
	    221 3608
	    249 3548
	    308 3466
	    281 3425
	    255 3401
	    234 3387
	    221 3377
	    215 3369
	>;

	r_profile_t1_num = <100 >;
	r_profile_t1 = <
	    155 4308
	    155 4281
	    159 4264
	    160 4249
	    163 4236
	    165 4223
	    166 4210
	    169 4198
	    171 4187
	    171 4175
	    171 4163
	    175 4153
	    175 4141
	    178 4130
	    178 4118
	    180 4107
	    183 4097
	    184 4087
	    185 4080
	    191 4076
	    193 4066
	    191 4050
	    191 4031
	    193 4014
	    193 4000
	    196 3991
	    184 3983
	    200 3978
	    205 3973
	    206 3968
	    204 3961
	    203 3953
	    199 3945
	    198 3937
	    195 3930
	    190 3921
	    190 3912
	    189 3901
	    178 3891
	    171 3881
	    168 3871
	    166 3862
	    159 3855
	    156 3849
	    155 3843
	    155 3838
	    156 3833
	    158 3828
	    158 3824
	    156 3819
	    158 3815
	    158 3811
	    159 3808
	    160 3805
	    161 3802
	    163 3799
	    163 3796
	    164 3793
	    164 3790
	    165 3788
	    166 3786
	    168 3784
	    166 3781
	    166 3779
	    166 3777
	    165 3775
	    164 3773
	    161 3770
	    160 3767
	    156 3763
	    155 3760
	    153 3756
	    151 3752
	    149 3748
	    150 3745
	    150 3742
	    154 3740
	    154 3735
	    154 3730
	    156 3725
	    158 3720
	    160 3717
	    169 3711
	    170 3703
	    173 3697
	    178 3695
	    184 3693
	    191 3691
	    201 3689
	    211 3681
	    211 3655
	    221 3608
	    249 3548
	    308 3466
	    281 3425
	    255 3401
	    234 3387
	    221 3377
	    215 3369
	>;

	r_profile_t2_num = <100 >;
	r_profile_t2 = <
	    155 4308
	    155 4281
	    159 4264
	    160 4249
	    163 4236
	    165 4223
	    166 4210
	    169 4198
	    171 4187
	    171 4175
	    171 4163
	    175 4153
	    175 4141
	    178 4130
	    178 4118
	    180 4107
	    183 4097
	    184 4087
	    185 4080
	    191 4076
	    193 4066
	    191 4050
	    191 4031
	    193 4014
	    193 4000
	    196 3991
	    184 3983
	    200 3978
	    205 3973
	    206 3968
	    204 3961
	    203 3953
	    199 3945
	    198 3937
	    195 3930
	    190 3921
	    190 3912
	    189 3901
	    178 3891
	    171 3881
	    168 3871
	    166 3862
	    159 3855
	    156 3849
	    155 3843
	    155 3838
	    156 3833
	    158 3828
	    158 3824
	    156 3819
	    158 3815
	    158 3811
	    159 3808
	    160 3805
	    161 3802
	    163 3799
	    163 3796
	    164 3793
	    164 3790
	    165 3788
	    166 3786
	    168 3784
	    166 3781
	    166 3779
	    166 3777
	    165 3775
	    164 3773
	    161 3770
	    160 3767
	    156 3763
	    155 3760
	    153 3756
	    151 3752
	    149 3748
	    150 3745
	    150 3742
	    154 3740
	    154 3735
	    154 3730
	    156 3725
	    158 3720
	    160 3717
	    169 3711
	    170 3703
	    173 3697
	    178 3695
	    184 3693
	    191 3691
	    201 3689
	    211 3681
	    211 3655
	    221 3608
	    249 3548
	    308 3466
	    281 3425
	    255 3401
	    234 3387
	    221 3377
	    215 3369
	>;

	r_profile_t3_num = <100 >;
	r_profile_t3 = <
	    155 4308
	    155 4281
	    159 4264
	    160 4249
	    163 4236
	    165 4223
	    166 4210
	    169 4198
	    171 4187
	    171 4175
	    171 4163
	    175 4153
	    175 4141
	    178 4130
	    178 4118
	    180 4107
	    183 4097
	    184 4087
	    185 4080
	    191 4076
	    193 4066
	    191 4050
	    191 4031
	    193 4014
	    193 4000
	    196 3991
	    184 3983
	    200 3978
	    205 3973
	    206 3968
	    204 3961
	    203 3953
	    199 3945
	    198 3937
	    195 3930
	    190 3921
	    190 3912
	    189 3901
	    178 3891
	    171 3881
	    168 3871
	    166 3862
	    159 3855
	    156 3849
	    155 3843
	    155 3838
	    156 3833
	    158 3828
	    158 3824
	    156 3819
	    158 3815
	    158 3811
	    159 3808
	    160 3805
	    161 3802
	    163 3799
	    163 3796
	    164 3793
	    164 3790
	    165 3788
	    166 3786
	    168 3784
	    166 3781
	    166 3779
	    166 3777
	    165 3775
	    164 3773
	    161 3770
	    160 3767
	    156 3763
	    155 3760
	    153 3756
	    151 3752
	    149 3748
	    150 3745
	    150 3742
	    154 3740
	    154 3735
	    154 3730
	    156 3725
	    158 3720
	    160 3717
	    169 3711
	    170 3703
	    173 3697
	    178 3695
	    184 3693
	    191 3691
	    201 3689
	    211 3681
	    211 3655
	    221 3608
	    249 3548
	    308 3466
	    281 3425
	    255 3401
	    234 3387
	    221 3377
	    215 3369
	>;
};
